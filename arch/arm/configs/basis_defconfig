## arch/ppc/mach-mpc85xx/Kconfig
```kconfig
if ARCH_MPC85XX

config MMU
	default y

config BTB
	bool
	default y if P2020RDB || P1022DS || DA923RC || CORAZON || CORONET

config BAREBOX_MAX_IMAGE_SIZE
	hex
	default 0x80000

config TEXT_BASE
	hex
	default 0xeff80000 if P1010RDB || P2020RDB || P1022DS || CORAZON || CORONET
	default 0xfff80000 if DA923RC

config TEXT_BASE
	hex
	default 0xfffffffc if DA923RC
	default 0xeffffffc if P1010RDB || P2020RDB || P1022DS || CORAZON || CORONET

config MPC85xx
	bool
	default y

config BOOKE
	bool
	default y

config E500
	bool
	default y

config E500MC
	bool
	default y if CORONET

config SYS_CACHE_STASHING
	bool
	default y if CORONET

config BACKSIDE_L2_CACHE
	bool
	default y if CORONET
	
config ENABLE_36BIT_PHYS
	bool
	default y if CORONET

config PHYS_ADDR_T_64BIT
	bool
	default y if CORONET

config E500_LEGACY_SMP
	bool
	default y if CORAZON || CORONET

config BBOX_PLATFORM
	string
	default "corazon" if CORAZON
	default "coronet" if CORONET
   
choice
	prompt "Select your board"
config P1010RDB
	bool "P1010RDB"
	select P1010
	select DDR_SPD
	select FSL_DDR3
	help
	  Say Y here if you are using the Freescale P1010RDB

config P2020RDB
	bool "P2020RDB"
	select P2020
 	select FSL_ELBC
	help
	  Say Y here if you are using the Freescale P2020RDB

config P1022DS
	bool "P1022DS"
	select P1022
	select DDR_SPD
	select FSL_DDR3
	select FSL_ELBC
	help
	  Say Y here if you are using the Freescale P1022DS

config DA923RC
	bool "DA923RC"
	select MPC8544
	select DDR_SPD
	select FSL_DDR2
	help
	Say Y here if you are using the GE Intelligent Platforms DA923RC

config CORAZON
	bool "CORAZON"
	select POLLER
	select WATCHDOG
	help
	Say Y here if you are using the Westermo Corazon

config CORONET
	bool "CORONET"
	select POLLER
	select WATCHDOG
        select GPIOLIB
	help
	Say Y here if you are using the Westermo Coronet
endchoice
endif

config P1010
	select FSL_IFC
	select FSL_ERRATUM_IFC_A002769
	select FSL_ERRATUM_P1010_A003549
	select FSL_ERRATUM_IFC_A003399
	bool

config P2020
	bool

config P1022
	bool

config MPC8544
	bool

if CORONET
config T1023
	bool
	default y

config FSL_DDR3
	bool
	default y
endif

config FSL_DDR2
	bool

config FSL_DDR3
	bool

config FSL_IFC
	bool

config FSL_ELBC
	bool
	default y if P2020RDB || P1022DS || CORAZON || CORONET

config FSL_ERRATUM_IFC_A002769
	bool

config FSL_ERRATUM_IFC_A003399
	bool

config FSL_ERRATUM_P1010_A003549
	bool


if CORAZON
config P1020
	bool
	default y

config FSL_DDR3
	bool
	default y

config BOARD_RESET
	bool
	default y
endif

if CORONET
config T1023
	bool
	default y

config FSL_DDR3
	bool
	default y
endif
```

## drivers/net/phy/Kconfig
```kconfig
#
# PHY Layer Configuration
#

menu "phylib"

if PHYLIB

comment "MII PHY device drivers"

config AR8327N_PHY
	bool "Driver for QCA AR8327N PHYs"
	---help---
	  Currently supports the AR8327N PHY.

config AT803X_PHY
	bool "Driver for Atheros AT803X PHYs"
	---help---
	  Currently supports the AT8030, AT8031 and AT8035 PHYs.

config LXT_PHY
	bool "Driver for the Intel LXT PHYs"
	---help---
	  Currently supports the lxt971 PHY.

config MARVELL_PHY
	tristate "Drivers for Marvell PHYs"
	---help---
	  Add support for various Marvell PHYs (e.g. 88E1121R).

config MICREL_PHY
	bool "Driver for Micrel PHYs"
	---help---
	  Supports the KSZ9021, VSC8201, KS8001 PHYs.

config NATIONAL_PHY
	bool "Driver for National Semiconductor PHYs"
	---help---
	  Currently supports the DP83865 PHY.

config REALTEK_PHY
	bool "Driver for Realtek PHYs"
	---help---
	  Currently supports the RTL8211B/E/DN PHY.

config SMSC_PHY
	bool "Drivers for SMSC PHYs"
	---help---
	  Currently supports the LAN83C185, LAN8187 and LAN8700 PHYs

config MV88E6XXX_PHY
	bool "Driver for Marvell's SoHo Switches"
	depends on MDIO_SMI
	---help---
	  Currenly supports MV88E6095/6097/6352

comment "MII bus device drivers"

config MDIO_MVEBU
	bool "Driver for MVEBU SoC MDIO bus"
	depends on ARCH_MVEBU
	---help---
	  Driver for the MDIO bus found on Marvell EBU SoCs.

config MDIO_MEMAC
	bool "Driver for QorIQ mEMAC MDIO bus"
	depends on ARCH_MPC85XX
	---help---
	  Driver for the MDIO bus found on Freescale's QorIQ Multirate
	  Ethernet MACs.

config MDIO_SMI
	bool "SMI Addressing Protocol"
	---help---
	  Support for Marvell's SMI addressing protocol over MDIO


config MDIO_BITBANG
        bool "Support for bitbanged MDIO buses"
	---help---
          This module implements the MDIO bus protocol in software,
          for use by low level drivers that export the ability to
          drive the relevant pins.

          If in doubt, say N.

config MDIO_GPIO
	bool "Support for GPIO lib-based bitbanged MDIO buses"
	depends on MDIO_BITBANG && GPIOLIB
	---help---
	  Supports GPIO lib-based MDIO busses.

config MDIO_MEMAC
	bool "Driver for QorIQ mEMAC MDIO bus"
	depends on ARCH_MPC85XX
	---help---
	  Driver for the MDIO bus found on Freescale's QorIQ Multirate
	  Ethernet MACs.

config MDIO_SMI
	bool "SMI Addressing Protocol"
	---help---
	  Support for Marvell's SMI addressing protocol over MDIO
endif

endmenu
```

## lib/westermo/Kconfig
```kconfig
config LIBWESTERMO
       bool "include Westermo library routines"

config WMO_BACKPLANE
       bool
       depends on LIBWESTERMO && MV88E6XXX_PHY
       default y

config WMO_IDMEM
       string "Westermo IDMEM file"
       depends on LIBWESTERMO
       default "/dev/eeprom0" if BASIS || CORAZON || MACH_DAGGER
       default "/dev/eeprom1" if CORONET
```

## net/Kconfig
```kconfig
menuconfig NET
	bool "Networking Support"

if NET

config NET_NFS
	bool
	prompt "nfs support"

config NET_NETCONSOLE
	bool
	depends on !CONSOLE_NONE
	prompt "network console support"
	help
	  This option adds support for a simple udp based network console.

config NET_RESOLV
	bool
	prompt "dns support"

config NET_IFUP
	default y
	depends on !SHELL_NONE
	bool

config NET_PCAP
	bool
	prompt "pcap support"
	help
	  A lightweight network analyser, similar to tcpdump. Supports live
	  and background captures. Background captures are saved in libpcap
	  format, compatible with tcpdump and Wireshark.

config NET_DHCP
	bool
	prompt "dhcp support"

config NET_SNTP
	bool
	prompt "sntp support"

endif
```
